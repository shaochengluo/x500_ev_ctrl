## imu_bench/sensor_drivers_PX4/st/ism330dlc/Kconfig
```kconfig
menuconfig DRIVERS_IMU_ST_ISM330DLC
	bool "st ism330dlc"
	default n
	depends on SPI
	help
		Enable support for the ST ISM330DLC IMU driver.

if DRIVERS_IMU_ST_ISM330DLC

config DRIVERS_IMU_ST_ISM330DLC_SPI
	bool
	default y

endif
```
